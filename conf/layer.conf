## conf/layer.conf
```bitbake
# meta-yocto-building-raspberrypi4 layer configuration

BBPATH .= ":${LAYERDIR}"
BBFILES += "${LAYERDIR}/recipes-*/*/*.bb ${LAYERDIR}/recipes-*/*/*.bbappend"

BBFILE_COLLECTIONS += "myproject"
BBFILE_PATTERN_myproject = "^${LAYERDIR}/"
BBFILE_PRIORITY_myproject = "6"
```

## conf/machine/raspberrypi4-64.conf
```bitbake
# Custom machine config for Raspberry Pi 4

MACHINE = "raspberrypi4-64"

# Enable UART for serial console
ENABLE_UART = "1"

# Extra features
EXTRA_IMAGE_FEATURES += "debug-tweaks"
IMAGE_INSTALL:append = " packagegroup-core-ssh-openssh"

# Parallel build settings for my machine (4 cores)
BB_NUMBER_THREADS ?= "4"
PARALLEL_MAKE ?= "-j 4"
```
